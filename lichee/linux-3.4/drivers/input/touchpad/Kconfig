## lichee/linux-3.4/drivers/input/touchpad/Kconfig
```kconfig
#
# Touchscreen driver configuration
#
menuconfig INPUT_TOUCHPAD
	bool "Touchpad"
	help
	  Say Y here, and a list of supported touchpad will be displayed.
	  This option doesn't affect the kernel.

	  If unsure, say Y.

if INPUT_TOUCHPAD

source "drivers/input/touchpad/gsl680/Kconfig"

endif
```

## lichee/linux-3.4/drivers/input/touchpad/gsl680/Kconfig
```kconfig
#
#  Touchpad driver configuration
#

config TOUCHPAD_GSL680
       tristate  "touchpad gsl680 driver"
       default m
       depends on INPUT && I2C
       help
         ft5x touchpad driver
```

## lichee/linux-3.4/drivers/staging/iio/imu/inv_mpu20602/Kconfig
```kconfig
#
# inv-mpu-iio driver for Invensense MPU devices
#
config INV_MPU20602_IIO
	tristate "Invensense MPU devices"
	depends on I2C && SYSFS && IIO && IIO_KFIFO_BUF && IIO_TRIGGER
	default n
	help
	  This driver supports the Invensense ICM20648/20608/20602/20608D devices.
	  This driver can be built as a module. The module will be called
	  inv-mpu-iio.

config INV_MPU_IIO
	tristate "Invensense MPU devices"
	depends on I2C && SYSFS && IIO && IIO_KFIFO_BUF && IIO_TRIGGER
	default n
	help
	  This driver supports the Invensense ICM20648/20690/20602/20608D/20609/20689 devices.
	  This driver can be built as a module. The module will be called
	  inv-mpu-iio.

config INV_MPU_IIO_ICM20648
	tristate  "Invensense ICM20648 devices"
	depends on INV_MPU_IIO
	default n
	help
	  This driver supports the Invensense ICM20648 devices.
	  This driver can be built as a module. The module will be called
	  inv-mpu-iio.

config INV_MPU_IIO_ICM20608D
	tristate  "Invensense ICM20608D/20609/20689 devices"
	depends on INV_MPU_IIO
	default n
	help
	  This driver supports the Invensense ICM20608D/20609/20689 devices.
	  This driver can be built as a module. The module will be called
	  inv-mpu-iio.

config INV_MPU_IIO_ICM20690
        tristate  "Invensense ICM20690 devices"
        depends on INV_MPU_IIO
        default n
        help
          This driver supports the Invensense ICM20690 devices.
          This driver can be built as a module. The module will be called
          inv-mpu-iio.

config INV_MPU_IIO_ICM20602
        tristate  "Invensense ICM20602 devices"
        depends on INV_MPU_IIO
        default n
        help
          This driver supports the Invensense ICM20602 devices.
          This driver can be built as a module. The module will be called
          inv-mpu-iio.

config DTS_INV_MPU_IIO
	bool  "Invensense MPU driver using Device Tree Structure (DTS)"
	depends on INV_MPU_IIO
	default n
	help
	  This enables Invensense MPU devices to use Device Tree Structure.
	  DTS must be enabled in the system.

config INV_MPU_IIO_SPI
	tristate "Invensense MPU device on SPI bus"
	depends on SPI && SYSFS && IIO && IIO_KFIFO_BUF && IIO_TRIGGER && !INV_MPU && !INV_MPU_IIO && !DTS_INV_MPU_IIO
	default n
        help
          This driver supports the Invensense ICM206XX devices.
          This driver can be built as a module. The module will be called
          inv-mpu-iio.

config INV_MPU_DRAGON_IIO
	bool "Invensense MPU driver for Dragon board"
	depends on INV_MPU_IIO
	default n
	help
	  This enables Invensense MPU devices for dragon board platform.
```
